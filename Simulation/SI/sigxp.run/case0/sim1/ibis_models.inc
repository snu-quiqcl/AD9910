DATAPOINTS BDRVR SPARTAN7_LVCMOS33_S_12_HR_Typ_27degC
MODEL_VERSION=2.0
PullUpReference=3.3
PullDownReference=0
PowerClampReference=3.3
GroundClampReference=0

DATAPOINTS AC_PARAM
dVGateOpen=1
dVGateClose=0
ENABLE_ON_VOLT=1
ENABLE_OFF_VOLT=0
RISE_TIME=2.40983e-09
FALL_TIME=1.399e-09
dVdtr=9.49028e+08
dVdtf=1.76614e+09
END AC_PARAM

DATAPOINTS LOGIC_PARAM
VHI_MIN=2
VLO_MAX=0.8
END LOGIC_PARAM

DATAPOINTS VI POWER_CLAMP
3.28 3.564
3.24 3.502
3.2 3.441
3.16 3.379
3.12 3.318
3.08 3.256
3.04 3.195
3 3.133
2.96 3.072
2.92 3.01
2.88 2.949
2.84 2.887
2.8 2.826
2.76 2.765
2.72 2.703
2.68 2.642
2.64 2.58
2.6 2.519
2.56 2.457
2.52 2.396
2.48 2.334
2.44 2.273
2.4 2.211
2.36 2.15
2.32 2.088
2.28 2.027
2.24 1.966
2.2 1.904
2.16 1.843
2.12 1.781
2.08 1.72
2.04 1.658
2 1.597
1.96 1.535
1.92 1.474
1.88 1.412
1.84 1.351
1.8 1.29
1.76 1.228
1.72 1.167
1.68 1.105
1.64 1.044
1.6 0.9827
1.56 0.9213
1.52 0.86
1.48 0.7987
1.44 0.7375
1.4 0.6762
1.36 0.615
1.32 0.5553
1.28 0.4967
1.24 0.4381
1.2 0.3796
1.16 0.321
1.12 0.2663
1.08 0.2147
1.04 0.163
1 0.118
0.96 0.08102
0.92 0.05554
0.88 0.04138
0.84 0.03316
0.8 0.02805
0.76 0.0245
0.72 0.02113
0.68 0.01775
0.64 0.01437
0.6 0.01099
0.56 0.008919
0.52 0.006984
0.48 0.00505
0.44 0.003116
0.4 0.001182
0.36 0.0007935
0.32 0.0005628
0.28 0.0003322
0.24 0.0001015
0.2 4.709e-06
0.16 2.65e-06
0.12 5.904e-07
0.08 7.907e-08
0.04 2.938e-08
0 1.962e-08
END VI POWER_CLAMP

DATAPOINTS VI ground_clamp
-3.3 -3.592
-3.23 -3.485
-3.16 -3.378
-3.09 -3.271
-3.02 -3.164
-2.95 -3.057
-2.88 -2.95
-2.81 -2.844
-2.74 -2.737
-2.67 -2.63
-2.6 -2.523
-2.53 -2.416
-2.46 -2.309
-2.39 -2.202
-2.32 -2.095
-2.25 -1.988
-2.18 -1.881
-2.11 -1.774
-2.04 -1.668
-1.97 -1.561
-1.9 -1.454
-1.83 -1.347
-1.76 -1.24
-1.69 -1.133
-1.62 -1.027
-1.55 -0.9221
-1.48 -0.8171
-1.41 -0.7121
-1.34 -0.607
-1.27 -0.505
-1.2 -0.4209
-1.13 -0.3369
-1.06 -0.2528
-0.99 -0.1688
-0.92 -0.0923
-0.85 -0.06205
-0.78 -0.04515
-0.71 -0.03339
-0.64 -0.02163
-0.57 -0.01324
-0.5 -0.006516
-0.43 -0.001313
-0.36 -0.0002249
-0.29 -3.255e-05
-0.22 -6.704e-06
-0.15 -4.021e-07
-0.08 -3.203e-08
-0.01 -1.438e-08
0.06 -1.227e-08
0.13 -1.136e-08
0.2 -1.075e-08
0.27 -1.027e-08
0.34 -9.826e-09
0.41 -9.414e-09
0.48 -9.005e-09
0.55 -8.613e-09
0.62 -8.225e-09
0.69 -7.845e-09
0.76 -7.466e-09
0.83 -7.088e-09
0.9 -6.711e-09
0.97 -6.335e-09
1.04 -5.955e-09
1.11 -5.579e-09
1.18 -5.198e-09
1.25 -4.833e-09
1.32 -4.482e-09
1.39 -4.123e-09
1.46 -3.738e-09
1.53 -3.199e-09
1.6 -2.521e-09
1.67 -1.751e-09
1.74 -9.51e-10
1.81 -3.026e-10
1.88 5.343e-10
1.95 1.529e-09
2.02 2.077e-09
2.09 2.572e-09
2.16 3.18e-09
2.23 3.744e-09
2.3 4.274e-09
2.37 4.807e-09
2.44 5.354e-09
2.51 5.902e-09
2.58 6.45e-09
2.65 7.019e-09
2.72 7.641e-09
2.79 8.264e-09
2.86 8.886e-09
2.93 9.509e-09
3 1.024e-08
3.07 1.148e-08
3.14 1.411e-08
3.21 1.675e-08
3.28 1.939e-08
END VI ground_clamp

DATAPOINTS VI PULL_UP
3.3 0.03786
3.2 0.03786
3.1 0.03786
3 0.03786
2.9 0.03786
2.8 0.03786
2.7 0.03786
2.6 0.03786
2.5 0.03786
2.4 0.03786
2.3 0.03786
2.2 0.03786
2.1 0.03786
2 0.03786
1.9 0.03786
1.8 0.03786
1.7 0.03786
1.6 0.03786
1.5 0.03786
1.4 0.03786
1.3 0.03786
1.2 0.03786
1.1 0.03786
1 0.03786
0.9 0.03786
0.8 0.03786
0.7 0.03595
0.6 0.0352
0.5 0.031471
0.4 0.025401
0.3 0.0205318
0.2 0.0139834
0.1 0.0069299
0 4.936e-08
-0.1 -0.006506
-0.2 -0.01284
-0.3 -0.0186
-0.4 -0.0239
-0.5 -0.0287
-0.6 -0.03286
-0.7 -0.03685
-0.8 -0.04031
-0.9 -0.04327
-1 -0.04559
-1.1 -0.04751
-1.2 -0.04886
-1.3 -0.04977
-1.4 -0.05037
-1.5 -0.05081
-1.6 -0.05115
-1.7 -0.05144
-1.8 -0.0517
-1.9 -0.05193
-2 -0.05214
-2.1 -0.05235
-2.2 -0.05254
-2.3 -0.05272
-2.4 -0.05289
-2.5 -0.06212
-2.6 -0.06225
-2.7 -0.06238
-2.8 -0.0625
-2.9 -0.06262
-3 -0.06274
-3.1 -0.06285
-3.2 -0.06296
-3.3 -0.06307
-3.4 -0.0631799
-3.5 -0.0632986
-3.6 -0.0633507
-3.7 -0.0633507
-3.8 -0.0633507
-3.9 -0.0633507
-4 -0.0633507
-4.1 -0.0633507
-4.2 -0.0633507
-4.3 -0.0633507
-4.4 -0.0633507
-4.5 -0.0633507
-4.6 -0.0633507
-4.7 -0.0633507
-4.8 -0.0633507
-4.9 -0.0633507
-5 -0.0633507
-5.1 -0.0633507
-5.2 -0.0633507
-5.3 -0.0633507
-5.4 -0.0633507
-5.5 -0.0633507
-5.6 -0.0633507
-5.7 -0.0633507
-5.8 -0.0633507
-5.9 -0.0633507
-6 -0.0633507
-6.1 -0.0633507
-6.2 -0.0633507
-6.3 -0.0633507
-6.4 -0.0633507
-6.5 -0.0633507
-6.6 -0.0633507
END VI PULL_UP

DATAPOINTS VI pull_down
-3.3 -0.04225
-3.2 -0.04225
-3.1 -0.04225
-3 -0.04225
-2.9 -0.04225
-2.8 -0.04225
-2.7 -0.04225
-2.6 -0.04225
-2.5 -0.04225
-2.4 -0.04225
-2.3 -0.04225
-2.2 -0.04225
-2.1 -0.04225
-2 -0.04225
-1.9 -0.04225
-1.8 -0.04225
-1.7 -0.04225
-1.6 -0.04225
-1.5 -0.04225
-1.4 -0.04225
-1.3 -0.04225
-1.2 -0.04225
-1.1 -0.04225
-1 -0.04225
-0.9 -0.04225
-0.8 -0.04225
-0.7 -0.04225
-0.6 -0.04225
-0.5 -0.041786
-0.4 -0.0381758
-0.3 -0.0288013
-0.2 -0.0187488
-0.1 -0.0089709
0 0.0008109
0.1 0.009922
0.2 0.01686
0.3 0.0238
0.4 0.03074
0.5 0.03767
0.6 0.0418
0.7 0.04518
0.8 0.04856
0.9 0.05169
1 0.05236
1.1 0.05303
1.2 0.0537
1.3 0.05428
1.4 0.05455
1.5 0.05483
1.6 0.0551
1.7 0.05512
1.8 0.05522
1.9 0.05532
2 0.05556
2.1 0.05562
2.2 0.0558
2.3 0.0558
2.4 0.05592
2.5 0.06033
2.6 0.06064
2.7 0.06075
2.8 0.06076
2.9 0.06082
3 0.06083
3.1 0.0608999
3.2 0.0611586
3.3 0.0611586
3.4 0.0611586
3.5 0.0611586
3.6 0.0611586
3.7 0.0611586
3.8 0.0611586
3.9 0.0611586
4 0.0611586
4.1 0.0611586
4.2 0.0611586
4.3 0.0611586
4.4 0.0611586
4.5 0.0611586
4.6 0.0611586
4.7 0.0611586
4.8 0.0611586
4.9 0.0611586
5 0.0611586
5.1 0.0611586
5.2 0.0611586
5.3 0.0611586
5.4 0.0611586
5.5 0.0611586
5.6 0.0611586
5.7 0.0611586
5.8 0.0611586
5.9 0.0611586
6 0.0611586
6.1 0.0611586
6.2 0.0611586
6.3 0.0611586
6.4 0.0611586
6.5 0.0611586
6.6 0.0611586
END VI pull_down
datapoints tv RisingWaveform name=rise_1 R_fixture=50 V_fixture=3.3 
0 0.8292
2.5e-10 0.8292
5.1e-10 0.8291
7.6e-10 0.8261
1.01e-09 1.605
1.26e-09 2.93
1.52e-09 3.249
1.77e-09 3.288
2.02e-09 3.296
2.27e-09 3.297
2.53e-09 3.298
2.78e-09 3.298
3.03e-09 3.299
3.28e-09 3.299
3.54e-09 3.299
3.79e-09 3.299
4.04e-09 3.299
4.29e-09 3.299
4.55e-09 3.299
4.8e-09 3.299
5.05e-09 3.299
5.3e-09 3.299
5.56e-09 3.299
5.81e-09 3.299
6.06e-09 3.299
6.31e-09 3.299
6.57e-09 3.299
6.82e-09 3.299
7.07e-09 3.299
7.32e-09 3.299
7.58e-09 3.299
7.83e-09 3.299
8.08e-09 3.299
8.33e-09 3.299
8.59e-09 3.299
8.84e-09 3.299
9.09e-09 3.299
9.34e-09 3.299
9.6e-09 3.299
9.85e-09 3.299
1.01e-08 3.299
1.035e-08 3.299
1.061e-08 3.299
1.086e-08 3.299
1.111e-08 3.299
1.136e-08 3.299
1.162e-08 3.299
1.187e-08 3.299
1.212e-08 3.299
1.237e-08 3.299
1.263e-08 3.299
1.288e-08 3.299
1.313e-08 3.299
1.338e-08 3.299
1.364e-08 3.299
1.389e-08 3.299
1.414e-08 3.299
1.439e-08 3.299
1.465e-08 3.299
1.49e-08 3.299
1.515e-08 3.299
1.54e-08 3.299
1.566e-08 3.299
1.591e-08 3.299
1.616e-08 3.299
1.641e-08 3.299
1.667e-08 3.299
1.692e-08 3.299
1.717e-08 3.299
1.742e-08 3.299
1.768e-08 3.299
1.793e-08 3.3
1.818e-08 3.3
1.843e-08 3.3
1.869e-08 3.3
1.894e-08 3.3
4.4157e-08 3.3
End tv RisingWaveform name=rise_1
datapoints tv RisingWaveform name=rise_2 R_fixture=50 V_fixture=0 
0 0
1.4918e-10 2.7819e-06
2.9836e-10 3.5266e-06
4.4753e-10 2.3775e-08
5.9671e-10 -0.0002334
7.4589e-10 -0.00063245
8.9507e-10 0.0018535
1.0442e-09 0.066173
1.1934e-09 0.33702
1.3426e-09 0.646
1.4918e-09 0.98573
1.641e-09 1.2648
1.7901e-09 1.5081
1.9393e-09 1.6125
2.0885e-09 1.6917
2.2377e-09 1.7413
2.3868e-09 1.7749
2.536e-09 1.8038
2.6852e-09 1.8241
2.8344e-09 1.8442
2.9836e-09 1.8639
3.1327e-09 1.884
3.2819e-09 1.9042
3.4311e-09 1.922
3.5803e-09 1.9397
3.7294e-09 1.957
3.8786e-09 1.9732
4.0278e-09 1.9887
4.177e-09 2.0031
4.3262e-09 2.0171
4.4753e-09 2.0297
4.6245e-09 2.0414
4.7737e-09 2.0521
4.9229e-09 2.0624
5.072e-09 2.0726
5.2212e-09 2.0833
5.3704e-09 2.0931
5.5196e-09 2.1017
5.6688e-09 2.1092
5.8179e-09 2.1164
5.9671e-09 2.1235
6.1163e-09 2.1305
6.2655e-09 2.137
6.4146e-09 2.1434
6.5638e-09 2.1497
6.713e-09 2.1546
6.8622e-09 2.1593
7.0113e-09 2.1641
7.1605e-09 2.1689
7.3097e-09 2.1737
7.4589e-09 2.1777
7.6081e-09 2.1819
7.7572e-09 2.1867
7.9064e-09 2.1908
8.0556e-09 2.1944
8.2048e-09 2.1975
8.3539e-09 2.2005
8.5031e-09 2.2033
8.6523e-09 2.2062
8.8015e-09 2.2092
8.9507e-09 2.2122
9.0998e-09 2.2152
9.249e-09 2.2175
9.3982e-09 2.2199
9.5474e-09 2.2222
9.6965e-09 2.2242
9.8457e-09 2.2259
9.9949e-09 2.2283
1.0144e-08 2.2305
1.0293e-08 2.2323
1.0442e-08 2.2341
1.0592e-08 2.2358
1.0741e-08 2.2376
1.089e-08 2.2392
1.1039e-08 2.2404
1.1188e-08 2.2419
1.1338e-08 2.2437
1.1487e-08 2.245
1.1636e-08 2.2461
1.1785e-08 2.2473
1.1934e-08 2.2485
1.2083e-08 2.2497
1.2233e-08 2.2514
1.2382e-08 2.2531
1.2531e-08 2.2549
1.268e-08 2.2562
1.2829e-08 2.2568
1.2978e-08 2.2578
1.3128e-08 2.259
1.3277e-08 2.2596
1.3426e-08 2.2604
1.3575e-08 2.2615
1.3724e-08 2.2623
1.3874e-08 2.2629
1.4023e-08 2.2635
1.4172e-08 2.2641
1.4321e-08 2.2647
1.447e-08 2.2653
1.4619e-08 2.2659
1.4769e-08 2.2669
1.4918e-08 2.2681
1.5067e-08 2.2687
1.5216e-08 2.2693
1.5365e-08 2.2699
1.5514e-08 2.2704
1.5664e-08 2.271
1.5813e-08 2.271
1.5962e-08 2.2712
1.6111e-08 2.2718
1.626e-08 2.2724
1.641e-08 2.273
1.6559e-08 2.2736
1.6708e-08 2.2742
1.6857e-08 2.2747
1.7006e-08 2.275
1.7155e-08 2.275
1.7305e-08 2.2755
1.7454e-08 2.2761
1.7603e-08 2.2767
1.7752e-08 2.277
1.7901e-08 2.277
1.805e-08 2.2775
1.82e-08 2.278
1.8349e-08 2.278
1.8498e-08 2.2783
1.8647e-08 2.2788
1.8796e-08 2.279
1.8946e-08 2.279
1.9095e-08 2.2796
1.9244e-08 2.28
1.9393e-08 2.28
1.9542e-08 2.2804
1.9691e-08 2.281
1.9841e-08 2.281
1.999e-08 2.2812
2.0139e-08 2.2818
2.0288e-08 2.282
2.0437e-08 2.282
2.0587e-08 2.282
2.0736e-08 2.2821
2.0885e-08 2.2827
2.1034e-08 2.283
2.1183e-08 2.283
2.1332e-08 2.283
2.1482e-08 2.2831
2.1631e-08 2.2837
2.178e-08 2.284
2.1929e-08 2.284
2.2078e-08 2.284
2.2227e-08 2.284
2.2377e-08 2.284
2.2526e-08 2.2842
2.2675e-08 2.2848
2.2824e-08 2.285
2.2973e-08 2.285
2.3123e-08 2.285
2.3272e-08 2.285
2.3421e-08 2.285
2.357e-08 2.2853
2.3719e-08 2.2859
2.3868e-08 2.286
2.4018e-08 2.286
2.4167e-08 2.286
2.4316e-08 2.286
2.4465e-08 2.286
2.4614e-08 2.2865
2.4763e-08 2.287
2.4913e-08 2.287
2.5062e-08 2.287
2.5211e-08 2.287
2.536e-08 2.287
2.5509e-08 2.287
2.5659e-08 2.287
2.5808e-08 2.287
2.5957e-08 2.287
2.6106e-08 2.287
2.6255e-08 2.287
2.6404e-08 2.287
2.6554e-08 2.287
2.6703e-08 2.287
2.6852e-08 2.287
2.7001e-08 2.287
2.715e-08 2.287
2.73e-08 2.287
2.7449e-08 2.287
2.7598e-08 2.287
2.7747e-08 2.287
2.7896e-08 2.287
2.8045e-08 2.287
2.8195e-08 2.287
2.8344e-08 2.287
2.8493e-08 2.287
2.8642e-08 2.287
2.8791e-08 2.287
2.894e-08 2.287
2.909e-08 2.287
2.9239e-08 2.287
2.9388e-08 2.287
2.9537e-08 2.287
2.9686e-08 2.287
2.9836e-08 2.287
2.9985e-08 2.287
3.0134e-08 2.287
3.0283e-08 2.287
3.0432e-08 2.287
3.0581e-08 2.287
3.0731e-08 2.287
3.088e-08 2.287
3.1029e-08 2.287
3.1178e-08 2.287
3.1327e-08 2.287
3.1476e-08 2.287
3.1626e-08 2.287
3.1775e-08 2.287
3.1924e-08 2.287
3.2073e-08 2.287
3.2222e-08 2.287
3.2372e-08 2.287
3.2521e-08 2.287
3.267e-08 2.287
3.2819e-08 2.287
3.2968e-08 2.287
3.3117e-08 2.287
3.3267e-08 2.287
3.3416e-08 2.287
3.3565e-08 2.287
3.3714e-08 2.287
3.3863e-08 2.287
3.4013e-08 2.287
3.4162e-08 2.287
3.4311e-08 2.287
3.446e-08 2.287
3.4609e-08 2.287
3.4758e-08 2.287
3.4908e-08 2.287
3.5057e-08 2.287
3.5206e-08 2.287
3.5355e-08 2.287
3.5504e-08 2.287
3.5653e-08 2.287
3.5803e-08 2.287
3.5952e-08 2.287
3.6101e-08 2.287
3.625e-08 2.287
3.6399e-08 2.287
3.6549e-08 2.287
3.6698e-08 2.287
3.6847e-08 2.287
3.6996e-08 2.287
3.7145e-08 2.287
3.7294e-08 2.287
3.7444e-08 2.287
3.7593e-08 2.287
3.7742e-08 2.287
3.7891e-08 2.287
3.804e-08 2.287
3.8189e-08 2.287
3.8339e-08 2.287
3.8488e-08 2.287
3.8637e-08 2.287
3.8786e-08 2.287
3.8935e-08 2.287
3.9085e-08 2.287
3.9234e-08 2.287
3.9383e-08 2.287
3.9532e-08 2.287
3.9681e-08 2.287
3.983e-08 2.287
3.998e-08 2.287
4.0129e-08 2.287
4.0278e-08 2.287
4.0427e-08 2.287
4.0576e-08 2.287
4.0725e-08 2.287
4.0875e-08 2.287
4.1024e-08 2.287
4.1173e-08 2.287
4.1322e-08 2.287
4.1471e-08 2.287
4.1621e-08 2.287
4.177e-08 2.287
4.1919e-08 2.287
4.2068e-08 2.287
4.2217e-08 2.287
4.2366e-08 2.287
4.2516e-08 2.287
4.2665e-08 2.287
4.2814e-08 2.287
4.2963e-08 2.287
4.3112e-08 2.287
4.3262e-08 2.287
4.3411e-08 2.287
4.356e-08 2.287
4.3709e-08 2.287
4.3858e-08 2.287
4.4007e-08 2.287
4.4157e-08 2.287
End tv RisingWaveform name=rise_2
datapoints tv FallingWaveform name=fall_1 R_fixture=50 V_fixture=3.3 
0 3.3
2.5e-10 3.3
5.1e-10 3.3
7.6e-10 3.301
1.01e-09 3.301
1.26e-09 3.315
1.52e-09 3.255
1.77e-09 2.943
2.02e-09 2.474
2.27e-09 1.969
2.53e-09 1.521
2.78e-09 1.217
3.03e-09 1.036
3.28e-09 0.9409
3.54e-09 0.9083
3.79e-09 0.8844
4.04e-09 0.8673
4.29e-09 0.8544
4.55e-09 0.8439
4.8e-09 0.8381
5.05e-09 0.8346
5.3e-09 0.833
5.56e-09 0.8315
5.81e-09 0.8308
6.06e-09 0.8302
6.31e-09 0.8297
6.57e-09 0.8296
6.82e-09 0.8296
7.07e-09 0.8295
7.32e-09 0.8295
7.58e-09 0.8294
7.83e-09 0.8294
8.08e-09 0.8293
8.33e-09 0.8293
8.59e-09 0.8292
8.84e-09 0.8293
9.09e-09 0.8293
9.34e-09 0.8293
9.6e-09 0.8293
9.85e-09 0.8294
1.01e-08 0.8293
1.035e-08 0.8293
1.061e-08 0.8293
1.086e-08 0.8292
1.111e-08 0.8292
1.136e-08 0.8292
1.162e-08 0.8292
1.187e-08 0.8293
1.212e-08 0.8293
1.237e-08 0.8293
1.263e-08 0.8293
1.288e-08 0.8292
1.313e-08 0.8292
1.338e-08 0.8292
1.364e-08 0.8292
1.389e-08 0.8292
1.414e-08 0.8292
1.439e-08 0.8292
1.465e-08 0.8292
1.49e-08 0.8292
1.515e-08 0.8292
End tv FallingWaveform name=fall_1
datapoints tv FallingWaveform name=fall_2 R_fixture=50 V_fixture=0 
0 2.291
2.5e-10 2.291
5.1e-10 2.291
7.6e-10 2.294
1.01e-09 2.293
1.26e-09 1.489
1.52e-09 0.7454
1.77e-09 0.292
2.02e-09 0.03907
2.27e-09 0.004489
2.53e-09 0.0008558
2.78e-09 0.0006007
3.03e-09 0.0003783
3.28e-09 0.000263
3.54e-09 0.000196
3.79e-09 0.0001369
4.04e-09 0
4.29e-09 0
4.55e-09 0
4.8e-09 0
5.05e-09 0
5.3e-09 0
5.56e-09 0
5.81e-09 0
6.06e-09 0
6.31e-09 0
6.57e-09 0
1.515e-08 0
End tv FallingWaveform name=fall_2

DATAPOINTS PARASITICS
C_COMP=5.23e-12
END PARASITICS

END BDRVR SPARTAN7_LVCMOS33_S_12_HR_Typ_27degC
